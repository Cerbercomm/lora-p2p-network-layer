## Kconfig
```kconfig
# ** Network Layer Drivers **

# Drivers specific kernel configuration
rsource "drivers/Kconfig"
```

## drivers/Kconfig
```kconfig
# ** Network over LBM (Lora Basics Modem) kernel configuration **

# Enable PHY layer
menuconfig LBM_P2P_NETWORK
        bool "Network over Lora (LBM) P2P"
        select EXPERIMENTAL
        depends on !LORA
        help
          Include support for network over LBM (Lora Basics Modem) PHY layer

if LBM_P2P_NETWORK

# Logging support for namespace
module = LBM_P2P_NETWORK
module-str = lbm-p2p-network
source "subsys/logging/Kconfig.template.log_config"

module = LBM_P2P_TRANSPORT
module-str = lbm-p2p-transport
source "subsys/logging/Kconfig.template.log_config"

# We need this enabled to use LoRa WAN stack
#   specific drivers with met dependencies will select this
config HAS_LBM_P2P_NETWORK_DRIVER
        bool

choice
        prompt "Network driver"
        default LBM_P2P_NETWORK_DIRECT
        help
          Which Lora P2P network driver to use

# Configuration specific to direct network
rsource "direct/Kconfig"

endchoice

config LBM_P2P_TRANSPORT_LAYER
        bool "Lora P2P transport network layer"
#        default y
        depends on HAS_LBM_P2P_NETWORK_DRIVER
        help
          Lora P2P transport network layer implementation.

config LBM_P2P_NETWORK_INIT_PRIORITY
        int "LoRa P2P network initialization priority"
        default 91
        help
          System initialization priority for LoRa P2P network drivers.
          Needs to be higher than LORA_BASICS_MODEM_INIT_PRIORITY

config LBM_P2P_TRANSPORT_INIT_PRIORITY
        int "LoRa P2P network initialization priority"
        default 92
        help
          System initialization priority for LoRa P2P network drivers.
          Needs to be higher than LBM_P2P_NETWORK_INIT_PRIORITY
          
endif # LBM_P2P_NETWORK
```

## drivers/direct/Kconfig
```kconfig
# ** Network over LBM drivers (loRa PHY) kernel configuration **
#      Direct network specific

config LBM_P2P_NETWORK_DIRECT
        bool "Direct P2P Lora network"
#        default y
        select HAS_LBM_P2P_NETWORK_DRIVER
        help
          Each node is able to send to and receive from every other node in the network.
```
